## boards/sc/scobc_v1/scobc_v1_versal_rpu_defconfig
```kconfig
# Enable UART driver
CONFIG_SERIAL=y

# Enable console
CONFIG_CONSOLE=y
CONFIG_UART_CONSOLE=y

# Run as XIP
CONFIG_XIP=y
```

## boards/shields/sc_scobc_v1_dev_board/Kconfig.defconfig
```kconfig
# Copyright (c) 2026 Space Cubics Inc.
# SPDX-License-Identifier: Apache-2.0

if SHIELD_SC_SCOBC_V1_DEV_BOARD

configdefault ETH_DRIVER
	default y if DT_HAS_XLNX_GEM_ENABLED

endif # SHIELD_SC_SCOBC_V1_DEV_BOARD
```
