/*
 * Copyright (c) 2026 Space Cubics Inc.
 *
 * SPDX-License-Identifier: Apache-2.0
 */

/* GEM1 is connected to a TI DP83867 PHY at MDIO address 1. */
&gem1 {
	/* GEM1_REF_CTRL is sourced from the RPLL (750 MHz) */
	clock-frequency = <DT_FREQ_M(750)>;
	phy-handle = <&dev_board_phy>;
	local-mac-address = [02 00 00 00 00 01];
	status = "disabled";
};

&gem1_mdio {
	dev_board_phy: ethernet-phy@1 {
		compatible = "ti,dp83867";
		reg = <1>;
		ti,interface-type = "rgmii-id";
		/* Match the board's 1.75 ns RX/TX delay straps. */
		ti,rx-internal-delay = <6>;
		ti,tx-internal-delay = <6>;
		status = "disabled";
	};
};
